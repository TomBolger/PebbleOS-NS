## pebble/services/notifications/Kconfig
```kconfig
# SPDX-FileCopyrightText: 2026 Core Devices LLC
# SPDX-License-Identifier: Apache-2.0

config SERVICE_NOTIFICATIONS
    bool "Notifications"
    help
      Notifications, alerts and ANCS.

if SERVICE_NOTIFICATIONS

module = SERVICE_NOTIFICATIONS
module-str = Notifications
source "subsys/logging/Kconfig.template.log_level"

config NOTIFICATION_IMAGE_RECENTS
    int "Notification images kept of recent notifications"
    default 0 if SCRATCH_HEAP_SHARED
    default 3
    help
      While notifications are on screen, the images of this many of
      them other than the one shown are kept, so going back to one
      needs no transfer. Each takes up to 40 KiB of the scratch heap.

config NOTIFICATION_MIRROR
    bool "Mirror the phone's notification shade"
    default y
    help
      Work with a phone app that mirrors its whole notification shade on
      the watch, filing each notification in the shade's sections: list
      notifications in those sections, with a Sections setting, and ask
      the phone to check what the watch holds when the launcher or
      Notifications opens (the notifSyncRequest preference).

      Say n for a phone app that sends notifications one at a time
      without sections, such as the stock Core app: they are then listed
      newest first, stacked as Group by says, and the watch sends no
      sync checks.

config NOTIFICATION_TEXT_BLOCK
    bool "Read round notifications in a block of one width"
    depends on PLATFORM_ROUND
    help
      A round notification's message runs as wide as the display is
      where it starts, and its lines keep that width down to where the
      display is as wide again, so lines read there never rewrap as the
      card scrolls. Text above and below them is rewrapped to fit inside
      the display, and the card scrolls in Moook steps that cut over to
      each new layout.

config SERVICE_ALERTS_LOG_LEVEL_RUNTIME
    default y if !RECOVERY_FW

module = SERVICE_ALERTS
module-str = Alert UI
source "subsys/logging/Kconfig.template.log_level"

endif
```
